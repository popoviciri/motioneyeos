## package/python-colorzero/Config.in
```kconfig
config BR2_PACKAGE_PYTHON_COLORZERO
	bool "python-colorzero"
	help
	  colorzero is a color manipulation library for Python

	  https://colorzero.readthedocs.io/en/release-1.1/
```

## package/python-gpiozero/Config.in
```kconfig
config BR2_PACKAGE_PYTHON_GPIOZERO
	bool "python-gpiozero"
    select BR2_PACKAGE_PYTHON_COLORZERO
	help
	  A simple interface to GPIO devices with Raspberry Pi.

	  https://github.com/RPi-Distro/python-gpiozero
```
